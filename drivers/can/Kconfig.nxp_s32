## drivers/can/Kconfig.nxp_s32
```kconfig
# Copyright 2022 NXP
# SPDX-License-Identifier: Apache-2.0

config CAN_NXP_S32_CANXL
	bool "NXP S32 CANXL driver"
	default y
	depends on DT_HAS_NXP_S32_CANXL_ENABLED
	select CAN_HAS_RX_TIMESTAMP
	select CAN_HAS_CANFD
	help
	  Enable support for NXP S32 CANXL driver.

if CAN_NXP_S32_CANXL
config CAN_NXP_S32_MAX_RX
	int "Maximum number of RX descriptors"
	depends on CAN_NXP_S32_CANXL
	default 16
	range 1 128
	help
	  Maximum number of RX descriptors.

config CAN_NXP_S32_MAX_TX
	int "Maximum number of TX descriptors"
	depends on CAN_NXP_S32_CANXL
	default 16
	range 1 128
	help
	  Maximum number of TX descriptors.

config CAN_NXP_S32_BRS
	bool "Frame uses CAN-FD Baud Rate Switch (BRS)"
	depends on CAN_FD_MODE
	default y
	help
	  Frame uses CAN-FD Baud Rate Switch.
endif # CAN_NXP_S32_CANXL
```

## drivers/pinctrl/Kconfig.lpc_iocon
```kconfig
# Copyright 2022, NXP
# SPDX-License-Identifier: Apache-2.0

config PINCTRL_NXP_IOCON
	bool "IOCON Pin controller driver for NXP LPC MCUs"
	default y
	depends on DT_HAS_NXP_LPC_IOCON_PINCTRL_ENABLED || \
		   DT_HAS_NXP_LPC11U6X_PINCTRL_ENABLED || \
		   DT_HAS_NXP_RT_IOCON_PINCTRL_ENABLED
	help
	  Enable pin controller driver for NXP LPC MCUs

if PINCTRL_NXP_IOCON

# To re-configure the Flash Pins to low power settings
# when going into low power modes, we need the pinctrl
# code to run from RAM.
if XIP && PM

choice PINCTRL_NXP_IOCON_MEM_TARGET
	prompt "Pinctrl driver relocation target"
	default PINCTRL_NXP_IOCON_MEM_SRAM
	help
	  Select the location to run the Pinctrl driver when using
	  the power management. One example where this is needed is to
	  reconfigure flash pins to low power settings when going into
	  low power modes.

config PINCTRL_NXP_IOCON_MEM_ITCM
	bool "ITCM"
	select CODE_DATA_RELOCATION

config PINCTRL_NXP_IOCON_MEM_SRAM
	bool "RAM"
	select CODE_DATA_RELOCATION_SRAM

endchoice

config PINCTRL_NXP_IOCON_MEM
	string
	default "ITCM" if PINCTRL_NXP_IOCON_MEM_ITCM
	default "RAM" if PINCTRL_NXP_IOCON_MEM_SRAM

endif # XIP || PM

endif # PINCTRL_NXP_IOCON_MEM_TARGET
```

## samples/boards/nxp_s32/netc/sample.yaml
```yaml
sample:
  description: Sample for show-casing the different use-cases of NXP S32 NETC driver
  name: NXP S32 NETC sample
tests:
  sample.boards.nxp_s32.netc.psi:
    depends_on: netif
    platform_allow: s32z270dc2_rtu0_r52
    build_only: true
    tags: net
  sample.boards.nxp_s32.netc.vsi_and_psi:
    depends_on: netif
    platform_allow: s32z270dc2_rtu0_r52
    extra_args: DTC_OVERLAY_FILE="./vsi-and-psi.overlay"
    build_only: true
    tags: net
```

## samples/drivers/can/babbling/boards/s32z270dc2_rtu0_r52.conf
```kconfig
# Copyright 2022 NXP
# SPDX-License-Identifier: Apache-2.0

CONFIG_SAMPLE_CAN_BABBLING_FD_MODE=y
```

## samples/net/sockets/can/boards/s32z270dc2_rtu0_r52.conf
```kconfig
# Copyright 2022 NXP
# SPDX-License-Identifier: Apache-2.0

CONFIG_CAN_FD_MODE=n
```

## soc/arm/nxp_imx/Kconfig.defconfig
```kconfig
# Copyright (c) 2017, NXP
# SPDX-License-Identifier: Apache-2.0

config SERIAL_INIT_PRIORITY
	default 55
	depends on SERIAL

config FLASH_MCUX_FLEXSPI_XIP
	bool "MCUX FlexSPI flash access with xip"
	default y
	depends on MEMC_MCUX_FLEXSPI
	depends on (CODE_FLEXSPI || CODE_FLEXSPI2 || SOC_SERIES_IMX_RT6XX)
	select XIP
	help
	  Allows using the flash API while running in XIP.
	  WARNING: It is possible to overwrite the running application itself.

source "soc/arm/nxp_imx/*/Kconfig.defconfig.series"
```

## tests/drivers/can/canfd/boards/s32z270dc2_rtu1_r52.conf
```kconfig
# Copyright 2022 NXP
# SPDX-License-Identifier: Apache-2.0

CONFIG_CAN_LOG_LEVEL_DBG=y
```
